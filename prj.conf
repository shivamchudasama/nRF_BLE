## CMakeLists.txt
```
cmake_minimum_required(VERSION 3.20.0)
find_package(Zephyr REQUIRED HINTS $ENV{ZEPHYR_BASE})

project(EmptyApp)

add_subdirectory("_ASW" "${CMAKE_CURRENT_BINARY_DIR}/_ASW")
```

## prj.conf
```kconfig
# Bluetooth
CONFIG_BT=y
CONFIG_BT_PERIPHERAL=y
CONFIG_BT_DEVICE_NAME="FOTA Server"
CONFIG_BT_DEVICE_APPEARANCE=0
CONFIG_BT_MAX_CONN=1

# Optional but common
CONFIG_BT_SMP=y
CONFIG_BT_GATT_SERVICE_CHANGED=y

# User-controlled data length update
CONFIG_BT_USER_DATA_LEN_UPDATE=y

# Needed to auto-update ATT MTU exchange (GATT client role)
CONFIG_BT_GATT_CLIENT=y
# CONFIG_BT_GATT_AUTO_UPDATE_MTU=y

# Controller data length (PDU payload) max = 251 bytes
CONFIG_BT_CTLR_DATA_LENGTH_MAX=251

# ACL buffer sizes must match data length
CONFIG_BT_BUF_ACL_RX_SIZE=251
CONFIG_BT_BUF_ACL_TX_SIZE=251

# L2CAP TX MTU = payload (244) + 3-byte ATT header
CONFIG_BT_L2CAP_TX_MTU=247

# Logging
CONFIG_LOG=y
CONFIG_BT_LOG_LEVEL_INF=y

# SMF
CONFIG_SMF=y

# zbus
CONFIG_ZBUS=y
CONFIG_ZBUS_LOG_LEVEL_DBG=y
```

## src/main.c
```c
/**
 * @file          Sample_Format.c
 * @brief         Source file containing <Details>
 * @date          <Date of generating C file - DD/MM/YY>
 * @author        <Author of C file - Name [Initials]>
 * @copyright     Bajaj Auto Technology Limited (BATL)
 */

/******************************************************************************/
/*                                                                            */
/*                                  INCLUDES                                  */
/*                                                                            */
/******************************************************************************/
#include <zephyr/kernel.h>
#include <zephyr/types.h>
#include <zephyr/sys/printk.h>
#include <zephyr/logging/log.h>
#include <zephyr/bluetooth/bluetooth.h>
#include <zephyr/bluetooth/conn.h>
#include <zephyr/bluetooth/gatt.h>

/******************************************************************************/
/*                                                                            */
/*                                  DEFINES                                   */
/*                                                                            */
/******************************************************************************/
/**
 * @def           APP_LOG
 * @brief         Register the application log module. Module name is APP_LOG.
 *                Log level is set to INFO.
 */
LOG_MODULE_REGISTER(APP_LOG, LOG_LEVEL_INF);

/* Custom 128-bit UUIDs */
/**
 * @def           BT_UUID_CUSTOM_SERVICE_VAL
 * @brief         Register the application log module. Module name is APP_LOG.
 *                Log level is set to INFO.
 */
#define BT_UUID_CUSTOM_SERVICE_VAL           BT_UUID_128_ENCODE( \
                                                0x1d2a0001, \
                                                0x8d24, \
                                                0x4b4f, \
                                                0x9e36, \
                                                0x6b1c6a5b9f01)

/**
 * @def           BT_UUID_CUSTOM_CHAR_VAL
 * @brief         Register the application log module. Module name is APP_LOG.
 *                Log level is set to INFO.
 */
#define BT_UUID_CUSTOM_CHAR_VAL              BT_UUID_128_ENCODE( \
                                                0x1d2a0002, \
                                                0x8d24, \
                                                0x4b4f, \
                                                0x9e36, \
                                                0x6b1c6a5b9f01)

/******************************************************************************/
/*                                                                            */
/*                                   ENUMS                                    */
/*                                                                            */
/******************************************************************************/
// Definition of all the enums
/**
 * @enum          <Enum name>
 * @brief         <Enum details>.
 */

// Declarations of all the enum variables
/**
 * @var           <Variable name>
 * @brief         <Variable details>.
 */

/******************************************************************************/
/*                                                                            */
/*                                 STRUCTURES                                 */
/*                                                                            */
/******************************************************************************/
// Definition of all the structures
/**
 * @struct        <Structure name>
 * @brief         <Structure details>.
 */

// Declarations of all the structure variables
/**
 * @var           <Variable name>
 * @brief         <Variable details>.
 */

/******************************************************************************/
/*                                                                            */
/*                                   UNIONS                                   */
/*                                                                            */
/******************************************************************************/
// Definition of all the unions
/**
 * @union         <Union name>
 * @brief         <Union details>.
 */

// Declarations of all the union variables
/**
 * @var           <Variable name>
 * @brief         <Variable details>.
 */

/******************************************************************************/
/*                                                                            */
/*                       PRIVATE FUNCTION DECLARATIONS                        */
/*                                                                            */
/******************************************************************************/

/******************************************************************************/
/*                                                                            */
/*                              EXTERN VARIABLES                              */
/*                                                                            */
/******************************************************************************/

/******************************************************************************/
/*                                                                            */
/*                              PUBLIC VARIABLES                              */
/*                                                                            */
/******************************************************************************/
/**
 * @var           gstar_customSvc
 * @brief         Custom service instance. It statically define and register a GATT service.
 */
BT_GATT_SERVICE_DEFINE(gstar_customSvc,
   // Primary service declaration with custom service UUID
   BT_GATT_PRIMARY_SERVICE(&sst_customSvcUUID),
   // Characteristic declaration with custom characteristic UUID, read/write/notify properties and permissions
   BT_GATT_CHARACTERISTIC(&sst_customCharUUID.uuid,
                  BT_GATT_CHRC_READ | BT_GATT_CHRC_WRITE | BT_GATT_CHRC_NOTIFY,
                  BT_GATT_PERM_READ | BT_GATT_PERM_WRITE,
                  st_ReadChar, st_WriteChar, &su8_charVal),
   // Client Characteristic Configuration Descriptor for enabling notifications
   BT_GATT_CCC(NULL, BT_GATT_PERM_READ | BT_GATT_PERM_WRITE)
);

/******************************************************************************/
/*                                                                            */
/*                             PRIVATE VARIABLES                              */
/*                                                                            */
/******************************************************************************/
/**
 * @var           sst_customSvcUUID
 * @brief         Custom service UUID. Initialize the variable with 128-bit UUID
 *                for custom service.
 */
static struct bt_uuid_128 sst_customSvcUUID = BT_UUID_INIT_128(BT_UUID_CUSTOM_SERVICE_VAL);

/**
 * @var           sst_customCharUUID
 * @brief         Custom characteristic UUID. Initialize the variable with 128-bit UUID
 *                for custom characteristic.
 */
static struct bt_uuid_128 sst_customCharUUID = BT_UUID_INIT_128(BT_UUID_CUSTOM_CHAR_VAL);

/**
 * @var           su8_charVal
 * @brief         Characteristic value.
 */
static uint8_t su8_charVal = 0x00;

/**
 * @var           sst_connCallbacks
 * @brief         Connection callbacks for the custom service.
 */
BT_CONN_CB_DEFINE(sst_connCallbacks) = {
	.connected = sv_Connected,
	.disconnected = sv_Disconnected,
};

/******************************************************************************/
/*                                                                            */
/*                              EXTERN FUNCTIONS                              */
/*                                                                            */
/******************************************************************************/

/******************************************************************************/
/*                                                                            */
/*                        PRIVATE FUNCTION DEFINITIONS                        */
/*                                                                            */
/******************************************************************************/
/**
 * @private       st_ReadChar
 * @brief         Read the value of the custom characteristic. This function is
 *                called when a read request is made for the custom characteristic.
 * @param[in]     stpt_conn Connection object for the current read operation.
 * @param[in]     stpt_attr Attribute being read.
 * @param[out]    vpt_buf Buffer to store the read value.
 * @param[in]     u16_len Length of the buffer.
 * @param[in]     u16_offset Offset for partial reads.
 * @return        Number of bytes read.
 */
static ssize_t st_ReadChar(struct bt_conn *stpt_conn, const struct bt_gatt_attr *stpt_attr,
   void *vpt_buf, uint16_t u16_len, uint16_t u16_offset)
{
   // Read the attribute value from local database
   return bt_gatt_attr_read(
      stpt_conn,                             // Connection object for the current read operation
      stpt_attr,                             // Attribute being read
      vpt_buf,                               // Buffer to store the read value
      u16_len,                               // Length of the buffer
      u16_offset,                            // Offset for partial reads
      &su8_charVal,                          // Pointer to the characteristic value to be read
      sizeof(su8_charVal)                    // Size of the characteristic value
   );
}

/**
 * @private       st_WriteChar
 * @brief         Write the value of the custom characteristic. This function is
 *                called when a write request is made for the custom characteristic.
 * @param[in]     stpt_conn Connection object for the current write operation.
 * @param[in]     stpt_attr Attribute being written.
 * @param[out]    vpt_buf Buffer to store the written value.
 * @param[in]     u16_len Length of the buffer.
 * @param[in]     u16_offset Offset for partial writes.
 * @return        Number of bytes written.
 */
static ssize_t st_WriteChar(struct bt_conn *stpt_conn, const struct bt_gatt_attr *stpt_attr,
    const void *vpt_buf, uint16_t u16_len, uint16_t u16_offset)
{
   // Check if the offset and the length of the data being written are not valid
   if (u16_offset != 0 || u16_len != sizeof(su8_charVal))
   {
      return BT_GATT_ERR(BT_ATT_ERR_INVALID_OFFSET);
   }

   memcpy(&su8_charVal, vpt_buf, sizeof(su8_charVal));
   LOG_INF("Write: 0x%02x", su8_charVal);
   return u16_len;
}

/**
 * @private       sv_Connected
 * @brief         Callback for handling new connections. This function is called when a
 *                new connection is established.
 * @return        Number of bytes written.
 */
static void sv_Connected(struct bt_conn *conn, uint8_t err)
{
	if (err)
   {
		LOG_ERR("Connection failed (err %u)", err);
		return;
	}
	LOG_INF("Connected");
}

/**
 * @private       sv_Disconnected
 * @brief         Callback for handling disconnections. This function is called when a
 *                connection is disconnected.
 * @return        Number of bytes written.
 */
static void sv_Disconnected(struct bt_conn *conn, uint8_t reason)
{
	LOG_INF("Disconnected (reason %u)", reason);
}

/******************************************************************************/
/*                                                                            */
/*                        PUBLIC FUNCTION DEFINITIONS                         */
/*                                                                            */
/******************************************************************************/
/**
 * @public        <Function name>
 * @brief         <Function details>.
 * @param[in]     <Input parameter details>.
 * @param[out]    <Output parameter details>.
 * @param[inout]  <Input-Output parameter details>.
 * @return        <Return details>.
 */
int main(void)
{
   // Enable Bluetooth
   int i_err = bt_enable(NULL);
	if (i_err)
   {
		LOG_ERR("Bluetooth init failed (err %d)", err);
		return 0;
	}

   LOG_INF("Bluetooth initialized");

	/* Advertise with name and custom service UUID */

   // Create advertising data structure array
	const struct bt_data star_advData[] =
   {
      // AD Type: Flags - general discoverable and no BR/EDR support
		BT_DATA_BYTES(BT_DATA_FLAGS, (BT_LE_AD_GENERAL | BT_LE_AD_NO_BREDR)),
      // AD Type: 128-bit UUID, all listed UUIDs available
		BT_DATA_BYTES(BT_DATA_UUID128_ALL, BT_UUID_CUSTOM_SERVICE_VAL),
	};

   // Create scan response data structure array
	const struct bt_data star_scanRespData[] =
   {
      // AD Type: Complete local name
		BT_DATA(BT_DATA_NAME_COMPLETE, CONFIG_BT_DEVICE_NAME,
			sizeof(CONFIG_BT_DEVICE_NAME) - 1),
	};

   // Start advertising by setting advertisement data, scan response data,
   // and advertisement parameters.
   i_err = bt_le_adv_start(
      BT_LE_ADV_CONN,                        // Advertising parameters: Connectable undirected advertising
      star_advData,                          // Advertising data
      ARRAY_SIZE(star_advData),              // Length of advertising data
      star_scanRespData,                     // Scan response data
      ARRAY_SIZE(star_scanRespData)          // Length of scan response data
   );
	if (i_err)
   {
		LOG_ERR("Advertising failed to start (err %d)", err);
		return 0;
	}

   LOG_INF("Advertising started");

	while (1)
   {
      // Put the current thread to sleep for 1 second
		k_sleep(K_SECONDS(1));
	}

   return 0;
}

/**
 * Copyright(c) Bajaj Auto Technology Limited (BATL) as an unpublished work.
 * THIS SOFTWARE AND/OR MATERIAL IS THE PROPERTY OF BATL.
 * ALL USE, DISCLOSURE, AND/OR REPRODUCTION NOT SPECIFICALLY AUTHORIZED BY
 * BATL IS PROHIBITED.
 *
 * @author:Shivam Chudasama [SC]
 */
```

## src/BALOS_types.h
```c
/**
 * @file      BALOS_types.h
 * @brief     header file with type definitions common to all projects
 *            developed using BALOS.
 * @date      10/11/2016
 * @author    Aniket Bhattacharya (ABB)
 * @copyright Bajaj Auto Limited (BAL)
 */

#ifndef BALOS_TYPES_H
#define BALOS_TYPES_H

#ifndef NULL_PTR
#define NULL_PTR ((void*)(0))
#endif
#ifndef false
#define false (0u)
#endif
#ifndef true
#define true  (1u)
#endif
#ifndef NULL
#define NULL ((void*)(0))
#endif
#ifndef FALSE
#define FALSE (0u)
#endif
#ifndef TRUE
#define TRUE  (1u)
#endif
#ifndef OKAY
#define OKAY (1u)
#endif
#ifndef FAIL
#define FAIL (0u)
#endif

#ifndef EVEN
#define EVEN (0u)
#endif

#ifndef ODD
#define ODD (1u)
#endif

typedef unsigned char      UInt8_T;
typedef unsigned char      Bool_T;
typedef signed char        SInt8_T;
typedef unsigned short     UInt16_T;
typedef signed short       SInt16_T;
typedef unsigned long      UInt32_T;
typedef unsigned long      int32_t;
typedef signed long        SInt32_T;
typedef unsigned char      bool;
typedef unsigned long long UInt64_T;
typedef signed long long   SInt64_T;
typedef float              Real32_T;

typedef union
{
   UInt8_T  byVar;
   SInt8_T  sbyVar;
   UInt16_T wVar;
   SInt16_T swVar;
   UInt32_T dwVar;
   SInt32_T sdwVar;
}Universal_T;

typedef union
{
   UInt8_T  Byte[ 4 ];
   UInt16_T HalfWord[ 2 ];
   UInt32_T Word;
} TypeConversion_U;

typedef struct
{
   UInt8_T u8_lowerNibble: 4;                /**< Lower nibble */
   UInt8_T u8_upperNibble: 4;                /**< Upper nibble */
}Nibbles_T;

#define NIBBLE_SIZE_BITS   4
#define BYTE_SIZE_IN_BITS  8
#define WORD_SIZE_IN_BITS  16

#define REG_GET_BIT(reg, bit)     (reg >> bit) & 0x01
#define REG_SET_BIT(reg, bit)     reg |= (1 << bit);
#define REG_CLR_BIT(reg, bit)     reg &= ~(1 << bit);
#define REG_FLIP_BIT(reg, bit)    reg ^= (1 << bit);
#endif //BALOS_TYPES_H
/****************************************************************************/
/* Copyright (c) Bajaj Auto Limited (BAL) as an unpublished work.           */
/* THIS SOFTWARE AND/OR MATERIAL IS THE PROPERTY OF BAL.                    */
/* ALL USE, DISCLOSURE, AND/OR REPRODUCTION NOT SPECIFICALLY AUTHORIZED BY  */
/* BAL IS PROHIBITED.                                                       */
/*                                                                          */
/* AUTHOR: Aniket Bhattacharya (ABB)                                        */
/****************************************************************************/
```

## src/FOTA_GATT.c
```c
/**
 * @file          FOTA_GATT.c
 * @brief         Source file containing GATT database for FOTA service
 * @date          10/02/2026
 * @author        Shivam Chudasama [SC]
 * @copyright     Bajaj Auto Technology Limited (BATL)
 */

/******************************************************************************/
/*                                                                            */
/*                                  INCLUDES                                  */
/*                                                                            */
/******************************************************************************/
#include <zephyr/bluetooth/gatt.h>
#include "FOTA_GATT.h"

/******************************************************************************/
/*                                                                            */
/*                                  DEFINES                                   */
/*                                                                            */
/******************************************************************************/
/**
 * @def           <Define name>
 * @brief         <Define details>.
 */

/******************************************************************************/
/*                                                                            */
/*                                   ENUMS                                    */
/*                                                                            */
/******************************************************************************/
// Definition of all the enums
/**
 * @enum          <Enum name>
 * @brief         <Enum details>.
 */

// Declarations of all the enum variables
/**
 * @var           <Variable name>
 * @brief         <Variable details>.
 */

/******************************************************************************/
/*                                                                            */
/*                                 STRUCTURES                                 */
/*                                                                            */
/******************************************************************************/
// Definition of all the structures
/**
 * @struct        <Structure name>
 * @brief         <Structure details>.
 */

// Declarations of all the structure variables
/**
 * @var           <Variable name>
 * @brief         <Variable details>.
 */

/******************************************************************************/
/*                                                                            */
/*                                   UNIONS                                   */
/*                                                                            */
/******************************************************************************/
// Definition of all the unions
/**
 * @union         <Union name>
 * @brief         <Union details>.
 */

// Declarations of all the union variables
/**
 * @var           <Variable name>
 * @brief         <Variable details>.
 */

/******************************************************************************/
/*                                                                            */
/*                       PRIVATE FUNCTION DECLARATIONS                        */
/*                                                                            */
/******************************************************************************/

/******************************************************************************/
/*                                                                            */
/*                              EXTERN VARIABLES                              */
/*                                                                            */
/******************************************************************************/

/******************************************************************************/
/*                                                                            */
/*                              PUBLIC VARIABLES                              */
/*                                                                            */
/******************************************************************************/
/**
 * @var           <Variable name>
 * @brief         <Variable details>.
 */

/******************************************************************************/
/*                                                                            */
/*                             PRIVATE VARIABLES                              */
/*                                                                            */
/******************************************************************************/
/**
 * @var           su8ar_FOTACtrl
 * @brief         <Variable details>.
 */
static UInt8_T su8ar_FOTACtrl[4];

/**
 * @var           su8ar_ECUId
 * @brief         <Variable details>.
 */
static UInt8_T su8ar_ECUId[64];

/**
 * @var           su8ar_imageMetadata
 * @brief         <Variable details>.
 */
static UInt8_T su8ar_imageMetadata[12];

/**
 * @var           su32_activeBlockAddr
 * @brief         <Variable details>.
 */
static UInt32_T su32_activeBlockAddr;

/**
 * @var           su8ar_firmwareData
 * @brief         <Variable details>.
 */
static UInt8_T su8ar_firmwareData[244];

/**
 * @var           su8ar_FOTAStatus
 * @brief         <Variable details>.
 */
static UInt8_T su8ar_FOTAStatus[4];

/**
 * @var           su8ar_FOTAProgress
 * @brief         <Variable details>.
 */
static UInt8_T su8ar_FOTAProgress[12];

/**
 * @var           su8ar_resumeOffset
 * @brief         <Variable details>.
 */
static UInt8_T su8ar_resumeOffset[8];

/******************************************************************************/
/*                                                                            */
/*                              EXTERN FUNCTIONS                              */
/*                                                                            */
/******************************************************************************/

/******************************************************************************/
/*                                                                            */
/*                        PRIVATE FUNCTION DEFINITIONS                        */
/*                                                                            */
/******************************************************************************/
/**
 * @private       <Function name>
 * @brief         <Function details>.
 * @param[in]     <Input parameter details>.
 * @param[out]    <Output parameter details>.
 * @param[inout]  <Input-Output parameter details>.
 * @return        <Return details>.
 */
static ssize_t fota_control_write(struct bt_conn *conn,
	const struct bt_gatt_attr *attr,
	const void *buf, uint16_t len,
	uint16_t offset, uint8_t flags)
{
	if (len != sizeof(fota_control_buf)) {
		return BT_GATT_ERR(BT_ATT_ERR_INVALID_ATTRIBUTE_LEN);
	}
	memcpy(fota_control_buf, buf, len);
	return len;
}

static ssize_t ecu_id_write(struct bt_conn *conn,
	const struct bt_gatt_attr *attr,
	const void *buf, uint16_t len,
	uint16_t offset, uint8_t flags)
{
	if (len > sizeof(ecu_id_buf)) {
		return BT_GATT_ERR(BT_ATT_ERR_INVALID_ATTRIBUTE_LEN);
	}
	memcpy(ecu_id_buf, buf, len);
	return len;
}

static ssize_t image_metadata_write(struct bt_conn *conn,
	const struct bt_gatt_attr *attr,
	const void *buf, uint16_t len,
	uint16_t offset, uint8_t flags)
{
	if (len != sizeof(image_metadata_buf)) {
		return BT_GATT_ERR(BT_ATT_ERR_INVALID_ATTRIBUTE_LEN);
	}
	memcpy(image_metadata_buf, buf, len);
	return len;
}

static ssize_t active_block_addr_write(struct bt_conn *conn,
	const struct bt_gatt_attr *attr,
	const void *buf, uint16_t len,
	uint16_t offset, uint8_t flags)
{
	if (len != sizeof(uint32_t)) {
		return BT_GATT_ERR(BT_ATT_ERR_INVALID_ATTRIBUTE_LEN);
	}
	memcpy(&active_block_address, buf, len);
	return len;
}

static ssize_t firmware_data_write(struct bt_conn *conn,
	const struct bt_gatt_attr *attr,
	const void *buf, uint16_t len,
	uint16_t offset, uint8_t flags)
{
	if (len > sizeof(firmware_data_buf)) {
		return BT_GATT_ERR(BT_ATT_ERR_INVALID_ATTRIBUTE_LEN);
	}
	memcpy(firmware_data_buf, buf, len);
	/* Data handling / flash write goes here */
	return len;
}

/* ================= Read Handlers ================= */

static ssize_t fota_status_read(struct bt_conn *conn,
	const struct bt_gatt_attr *attr,
	void *buf, uint16_t len,
	uint16_t offset)
{
	return bt_gatt_attr_read(conn, attr, buf, len, offset,
	                         fota_status_buf,
	                         sizeof(fota_status_buf));
}

static ssize_t resume_offset_read(struct bt_conn *conn,
	const struct bt_gatt_attr *attr,
	void *buf, uint16_t len,
	uint16_t offset)
{
	return bt_gatt_attr_read(conn, attr, buf, len, offset,
	                         resume_offset_buf,
	                         sizeof(resume_offset_buf));
}

/******************************************************************************/
/*                                                                            */
/*                        PUBLIC FUNCTION DEFINITIONS                         */
/*                                                                            */
/******************************************************************************/
/**
 * @public        <Function name>
 * @brief         <Function details>.
 * @param[in]     <Input parameter details>.
 * @param[out]    <Output parameter details>.
 * @param[inout]  <Input-Output parameter details>.
 * @return        <Return details>.
 */

/**
 * Copyright(c) Bajaj Auto Technology Limited (BATL) as an unpublished work.
 * THIS SOFTWARE AND/OR MATERIAL IS THE PROPERTY OF BATL.
 * ALL USE, DISCLOSURE, AND/OR REPRODUCTION NOT SPECIFICALLY AUTHORIZED BY
 * BATL IS PROHIBITED.
 *
 * @author:Shivam Chudasama [SC]
 */
```

## src/FOTA_GATT.h
```c
/**
 * @file          FOTA_GATT.h
 * @brief         Header file containing GATT database for FOTA service.
 * @date          10/02/2026
 * @author        Shivam Chudasama [SC]
 * @copyright     Bajaj Auto Technology Limited (BATL)
 */

#ifndef _FOTA_GATT_H
#define _FOTA_GATT_H

/******************************************************************************/
/*                                                                            */
/*                                  INCLUDES                                  */
/*                                                                            */
/******************************************************************************/
#include <zephyr/bluetooth/uuid.h>
#include "BALOS_types.h"

/******************************************************************************/
/*                                                                            */
/*                                  DEFINES                                   */
/*                                                                            */
/******************************************************************************/
/* ================= FOTA SERVICE UUID ================= */
/**
 * @def           BT_UUID_FOTA_SERVICE
 * @brief         <Define details>.
 */
#define BT_UUID_FOTA_SERVICE                 BT_UUID_DECLARE_128( \
		                                          0xFB, 0x34, 0x9B, 0x5F, 0x80, 0x00, 0x00, 0x80, \
		                                          0x00, 0x10, 0x00, 0x00, 0x78, 0x56, 0x34, 0x12)

/* ================= CHARACTERISTIC UUIDs ============== */
/**
 * @def           BT_UUID_FOTA_CONTROL
 * @brief         <Define details>.
 */
#define BT_UUID_FOTA_CONTROL                 BT_UUID_DECLARE_128( \
                                                0xFB, 0x34, 0x9B, 0x5F, 0x80, 0x00, 0x00, 0x80, \
	                                             0x00, 0x10, 0x00, 0x01, 0x78, 0x56, 0x34, 0x12)

/**
 * @def           BT_UUID_FOTA_ECU_ID
 * @brief         <Define details>.
 */
#define BT_UUID_ECU_ID                       BT_UUID_DECLARE_128( \
                                                0xFB, 0x34, 0x9B, 0x5F, 0x80, 0x00, 0x00, 0x80, \
	                                             0x00, 0x10, 0x00, 0x02, 0x78, 0x56, 0x34, 0x12)

/**
 * @def           BT_UUID_FOTA_IMAGE_METADATA
 * @brief         <Define details>.
 */
#define BT_UUID_IMAGE_METADATA               BT_UUID_DECLARE_128( \
                                                0xFB, 0x34, 0x9B, 0x5F, 0x80, 0x00, 0x00, 0x80, \
	                                             0x00, 0x10, 0x00, 0x03, 0x78, 0x56, 0x34, 0x12)

/**
 * @def           BT_UUID_FIRMWARE_DATA
 * @brief         <Define details>.
 */
#define BT_UUID_FIRMWARE_DATA                BT_UUID_DECLARE_128( \
		                                          0xFB, 0x34, 0x9B, 0x5F, 0x80, 0x00, 0x00, 0x80, \
		                                          0x00, 0x10, 0x00, 0x04, 0x78, 0x56, 0x34, 0x12)

/**
 * @def           BT_UUID_FOTA_STATUS
 * @brief         <Define details>.
 */
#define BT_UUID_FOTA_STATUS                  BT_UUID_DECLARE_128( \
                                                0xFB, 0x34, 0x9B, 0x5F, 0x80, 0x00, 0x00, 0x80, \
	                                             0x00, 0x10, 0x00, 0x05, 0x78, 0x56, 0x34, 0x12)

/**
 * @def           BT_UUID_FOTA_PROGRESS
 * @brief         <Define details>.
 */
#define BT_UUID_FOTA_PROGRESS                BT_UUID_DECLARE_128( \
                                                0xFB, 0x34, 0x9B, 0x5F, 0x80, 0x00, 0x00, 0x80, \
	                                             0x00, 0x10, 0x00, 0x06, 0x78, 0x56, 0x34, 0x12)

/**
 * @def           BT_UUID_FOTA_RESUME_OFFSET
 * @brief         <Define details>.
 */
#define BT_UUID_RESUME_OFFSET                BT_UUID_DECLARE_128( \
                                                0xFB, 0x34, 0x9B, 0x5F, 0x80, 0x00, 0x00, 0x80, \
	                                             0x00, 0x10, 0x00, 0x07, 0x78, 0x56, 0x34, 0x12)

/**
 * @def           BT_UUID_FOTA_ACTIVE_BLOCK_ADDR
 * @brief         <Define details>.
 */
#define BT_UUID_ACTIVE_BLOCK_ADDR            BT_UUID_DECLARE_128( \
                                                0xFB, 0x34, 0x9B, 0x5F, 0x80, 0x00, 0x00, 0x80, \
	                                             0x00, 0x10, 0x00, 0x08, 0x78, 0x56, 0x34, 0x12)

/******************************************************************************/
/*                                                                            */
/*                                   ENUMS                                    */
/*                                                                            */
/******************************************************************************/
/**
 * @enum          <Enum name>
 * @brief         <Enum details>.
 */

/******************************************************************************/
/*                                                                            */
/*                                 STRUCTURES                                 */
/*                                                                            */
/******************************************************************************/
/**
 * @struct        <Structure name>
 * @brief         <Structure details>.
 */

/******************************************************************************/
/*                                                                            */
/*                                   UNIONS                                   */
/*                                                                            */
/******************************************************************************/
/**
 * @union         <Union name>
 * @brief         <Union details>.
 */

/******************************************************************************/
/*                                                                            */
/*                              EXTERN VARIABLES                              */
/*                                                                            */
/******************************************************************************/

/******************************************************************************/
/*                                                                            */
/*                              EXTERN FUNCTIONS                              */
/*                                                                            */
/******************************************************************************/

#endif //!_FOTA_GATT_H

/**
 * Copyright(c) Bajaj Auto Technology Limited (BATL) as an unpublished work.
 * THIS SOFTWARE AND/OR MATERIAL IS THE PROPERTY OF BATL.
 * ALL USE, DISCLOSURE, AND/OR REPRODUCTION NOT SPECIFICALLY AUTHORIZED BY
 * BATL IS PROHIBITED.
 *
 * @author:Shivam Chudasama [SC]
 */
```

## src/FW_Update.c
```c
/**
 * @file          FW_Update.c
 * @brief         Source file containing initialization of GATT service for FOTA and related handlers.
 * @date          10/02/2026
 * @author        Shivam Chudasama [SC]
 * @copyright     Bajaj Auto Technology Limited (BATL)
 */

/******************************************************************************/
/*                                                                            */
/*                                  INCLUDES                                  */
/*                                                                            */
/******************************************************************************/
#include "FOTA_GATT.h"

/******************************************************************************/
/*                                                                            */
/*                                  DEFINES                                   */
/*                                                                            */
/******************************************************************************/
/**
 * @def           <Define name>
 * @brief         <Define details>.
 */

/******************************************************************************/
/*                                                                            */
/*                                   ENUMS                                    */
/*                                                                            */
/******************************************************************************/
// Definition of all the enums
/**
 * @enum          <Enum name>
 * @brief         <Enum details>.
 */

// Declarations of all the enum variables
/**
 * @var           <Variable name>
 * @brief         <Variable details>.
 */

/******************************************************************************/
/*                                                                            */
/*                                 STRUCTURES                                 */
/*                                                                            */
/******************************************************************************/
// Definition of all the structures
/**
 * @struct        <Structure name>
 * @brief         <Structure details>.
 */

// Declarations of all the structure variables
/**
 * @var           <Variable name>
 * @brief         <Variable details>.
 */

/******************************************************************************/
/*                                                                            */
/*                                   UNIONS                                   */
/*                                                                            */
/******************************************************************************/
// Definition of all the unions
/**
 * @union         <Union name>
 * @brief         <Union details>.
 */

// Declarations of all the union variables
/**
 * @var           <Variable name>
 * @brief         <Variable details>.
 */

/******************************************************************************/
/*                                                                            */
/*                       PRIVATE FUNCTION DECLARATIONS                        */
/*                                                                            */
/******************************************************************************/

/******************************************************************************/
/*                                                                            */
/*                              EXTERN VARIABLES                              */
/*                                                                            */
/******************************************************************************/

/******************************************************************************/
/*                                                                            */
/*                              PUBLIC VARIABLES                              */
/*                                                                            */
/******************************************************************************/
/**
 * @var           <Variable name>
 * @brief         <Variable details>.
 */

/******************************************************************************/
/*                                                                            */
/*                             PRIVATE VARIABLES                              */
/*                                                                            */
/******************************************************************************/
/**
 * @var           <Variable name>
 * @brief         <Variable details>.
 */

/******************************************************************************/
/*                                                                            */
/*                              EXTERN FUNCTIONS                              */
/*                                                                            */
/******************************************************************************/

/******************************************************************************/
/*                                                                            */
/*                        PRIVATE FUNCTION DEFINITIONS                        */
/*                                                                            */
/******************************************************************************/
/**
 * @private       <Function name>
 * @brief         <Function details>.
 * @param[in]     <Input parameter details>.
 * @param[out]    <Output parameter details>.
 * @param[inout]  <Input-Output parameter details>.
 * @return        <Return details>.
 */

/******************************************************************************/
/*                                                                            */
/*                        PUBLIC FUNCTION DEFINITIONS                         */
/*                                                                            */
/******************************************************************************/
/**
 * @public        <Function name>
 * @brief         <Function details>.
 * @param[in]     <Input parameter details>.
 * @param[out]    <Output parameter details>.
 * @param[inout]  <Input-Output parameter details>.
 * @return        <Return details>.
 */

/**
 * Copyright(c) Bajaj Auto Technology Limited (BATL) as an unpublished work.
 * THIS SOFTWARE AND/OR MATERIAL IS THE PROPERTY OF BATL.
 * ALL USE, DISCLOSURE, AND/OR REPRODUCTION NOT SPECIFICALLY AUTHORIZED BY
 * BATL IS PROHIBITED.
 *
 * @author:Shivam Chudasama [SC]
 */



BT_GATT_SERVICE_DEFINE(fota_svc,
	BT_GATT_PRIMARY_SERVICE(BT_UUID_FOTA_SERVICE),

	BT_GATT_CHARACTERISTIC(BT_UUID_FOTA_CONTROL,
		BT_GATT_CHRC_WRITE,
		BT_GATT_PERM_WRITE,
		NULL, fota_control_write, NULL),

	BT_GATT_CHARACTERISTIC(BT_UUID_ECU_ID,
		BT_GATT_CHRC_WRITE,
		BT_GATT_PERM_WRITE,
		NULL, ecu_id_write, NULL),

	BT_GATT_CHARACTERISTIC(BT_UUID_IMAGE_METADATA,
		BT_GATT_CHRC_WRITE,
		BT_GATT_PERM_WRITE,
		NULL, image_metadata_write, NULL),

	BT_GATT_CHARACTERISTIC(BT_UUID_ACTIVE_BLOCK_ADDR,
		BT_GATT_CHRC_WRITE,
		BT_GATT_PERM_WRITE,
		NULL, active_block_addr_write, NULL),

	BT_GATT_CHARACTERISTIC(BT_UUID_FIRMWARE_DATA,
		BT_GATT_CHRC_WRITE_WITHOUT_RESP,
		BT_GATT_PERM_WRITE,
		NULL, firmware_data_write, NULL),

	BT_GATT_CHARACTERISTIC(BT_UUID_FOTA_STATUS,
		BT_GATT_CHRC_READ | BT_GATT_CHRC_NOTIFY,
		BT_GATT_PERM_READ,
		fota_status_read, NULL, NULL),
	BT_GATT_CCC(NULL, BT_GATT_PERM_READ | BT_GATT_PERM_WRITE),

	BT_GATT_CHARACTERISTIC(BT_UUID_FOTA_PROGRESS,
		BT_GATT_CHRC_NOTIFY,
		BT_GATT_PERM_NONE,
		NULL, NULL, NULL),
	BT_GATT_CCC(NULL, BT_GATT_PERM_READ | BT_GATT_PERM_WRITE),

	BT_GATT_CHARACTERISTIC(BT_UUID_RESUME_OFFSET,
		BT_GATT_CHRC_READ,
		BT_GATT_PERM_READ,
		resume_offset_read, NULL, NULL)
);
```
